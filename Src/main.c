/* USER CODE BEGIN Header */
/**
  ******************************************************************************
  * @file           : main.c
  * @brief          : Main program body
  ******************************************************************************
  * @attention
  *
  * <h2><center>&copy; Copyright (c) 2021 STMicroelectronics.
  * All rights reserved.</center></h2>
  *
  * This software component is licensed by ST under BSD 3-Clause license,
  * the "License"; You may not use this file except in compliance with the
  * License. You may obtain a copy of the License at:
  *                        opensource.org/licenses/BSD-3-Clause
  *
  ******************************************************************************
  */
/* USER CODE END Header */

/* Includes ------------------------------------------------------------------*/
#include "main.h"
#include "usart.h"
#include "gpio.h"

/* Private includes ----------------------------------------------------------*/
/* USER CODE BEGIN Includes */

/* USER CODE END Includes */

/* Private typedef -----------------------------------------------------------*/
/* USER CODE BEGIN PTD */

/* USER CODE END PTD */

/* Private define ------------------------------------------------------------*/
/* USER CODE BEGIN PD */
#define INSTRUCTION 			0
#define DATA 							1
#define RESET 						GPIO_PIN_RESET
#define SET 							GPIO_PIN_SET
#define PAGE0 						0
#define PAGE1							1
#define ON	 							1
#define OFF 							0
/* USER CODE END PD */

/* Private macro -------------------------------------------------------------*/
/* USER CODE BEGIN PM */

/* USER CODE END PM */

/* Private variables ---------------------------------------------------------*/

/* USER CODE BEGIN PV */
uint8_t loadingImage_bgBlack [8][128] = {
    {0x00, 0xfe, 0xfe, 0x06, 0x06, 0x06, 0x06, 0x06, 0x06, 0x06, 0x06, 0x06, 0x06,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 0xfe, 0x00},
    {0x00, 0xff, 0xff, 0x00, 0x00, 0x00, 0x00, 0x00, 0x00, 0x00, 0x00, 0x00, 0x00,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 0xff, 0x00},
    {0x00, 0xff, 0xff, 0x00, 0x00, 0x00, 0x00, 0x00, 0x00, 0x00, 0x00, 0x00, 0x00,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 0xff, 0x00}, 
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    {0x00, 0x7f, 0x7f, 0x60, 0x60, 0x60, 0x60, 0x60, 0x60, 0x60, 0x60, 0x60, 0x60,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 0x7f, 0x00}
};

uint8_t titleImage_bgBlack [8][128] = {
    {0x00, 0xfe, 0xfe, 0x06, 0x06, 0x06, 0x06, 0x06, 0x06, 0x06, 0x06, 0x06, 0x06,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 0xfe, 0x00}, 
    {0x00, 0xff, 0xff, 0x00, 0x00, 0x00, 0x00, 0x00, 0x00, 0x00, 0x00, 0x00, 0x00,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 0xff, 0x00}, 
    {0x00, 0xff, 0xff, 0x00, 0x00, 0x00, 0x00, 0x00, 0x00, 0x00, 0x00, 0x00, 0x00,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 0xff, 0x00}, 
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    {0x00, 0x7f, 0x7f, 0x60, 0x60, 0x60, 0x60, 0x60, 0x60, 0x60, 0x60, 0x60, 0x60,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 0x7f, 0x00}
};
/* USER CODE END PV */

/* Private function prototypes -----------------------------------------------*/
void SystemClock_Config(void);
/* USER CODE BEGIN PFP */

/* USER CODE END PFP */

/* Private user code ---------------------------------------------------------*/
/* USER CODE BEGIN 0 */
void glcd_init(void);
void glcd_writeByte(uint8_t chip, uint8_t rs, uint8_t data);
void glcd_displayStatus(uint8_t status);
void glcd_fillScreen(uint8_t pixelStatus);
void glcd_drawImage(uint8_t imageArr[8][128]);
void glcd_loadingBar(void);
/* USER CODE END 0 */

/**
  * @brief  The application entry point.
  * @retval int
  */
int main(void)
{
  /* USER CODE BEGIN 1 */

  /* USER CODE END 1 */

  /* MCU Configuration--------------------------------------------------------*/

  /* Reset of all peripherals, Initializes the Flash interface and the Systick. */
  HAL_Init();

  /* USER CODE BEGIN Init */

  /* USER CODE END Init */

  /* Configure the system clock */
  SystemClock_Config();

  /* USER CODE BEGIN SysInit */

  /* USER CODE END SysInit */

  /* Initialize all configured peripherals */
  MX_GPIO_Init();
  MX_USART2_UART_Init();
  /* USER CODE BEGIN 2 */
	glcd_init();
	glcd_drawImage(loadingImage_bgBlack);
	glcd_loadingBar();
	glcd_drawImage(titleImage_bgBlack);
  /* USER CODE END 2 */

  /* Infinite loop */
  /* USER CODE BEGIN WHILE */
  while (1)
  {
    /* USER CODE END WHILE */

    /* USER CODE BEGIN 3 */
  }
  /* USER CODE END 3 */
}

/**
  * @brief System Clock Configuration
  * @retval None
  */
void SystemClock_Config(void)
{
  RCC_OscInitTypeDef RCC_OscInitStruct = {0};
  RCC_ClkInitTypeDef RCC_ClkInitStruct = {0};
  RCC_PeriphCLKInitTypeDef PeriphClkInit = {0};

  /** Configure the main internal regulator output voltage 
  */
  __HAL_PWR_VOLTAGESCALING_CONFIG(PWR_REGULATOR_VOLTAGE_SCALE1);
  /** Initializes the CPU, AHB and APB busses clocks 
  */
  RCC_OscInitStruct.OscillatorType = RCC_OSCILLATORTYPE_HSI;
  RCC_OscInitStruct.HSIState = RCC_HSI_DIV4;
  RCC_OscInitStruct.HSICalibrationValue = RCC_HSICALIBRATION_DEFAULT;
  RCC_OscInitStruct.PLL.PLLState = RCC_PLL_ON;
  RCC_OscInitStruct.PLL.PLLSource = RCC_PLLSOURCE_HSI;
  RCC_OscInitStruct.PLL.PLLMUL = RCC_PLLMUL_3;
  RCC_OscInitStruct.PLL.PLLDIV = RCC_PLLDIV_4;
  if (HAL_RCC_OscConfig(&RCC_OscInitStruct) != HAL_OK)
  {
    Error_Handler();
  }
  /** Initializes the CPU, AHB and APB busses clocks 
  */
  RCC_ClkInitStruct.ClockType = RCC_CLOCKTYPE_HCLK|RCC_CLOCKTYPE_SYSCLK
                              |RCC_CLOCKTYPE_PCLK1|RCC_CLOCKTYPE_PCLK2;
  RCC_ClkInitStruct.SYSCLKSource = RCC_SYSCLKSOURCE_PLLCLK;
  RCC_ClkInitStruct.AHBCLKDivider = RCC_SYSCLK_DIV1;
  RCC_ClkInitStruct.APB1CLKDivider = RCC_HCLK_DIV1;
  RCC_ClkInitStruct.APB2CLKDivider = RCC_HCLK_DIV1;

  if (HAL_RCC_ClockConfig(&RCC_ClkInitStruct, FLASH_LATENCY_0) != HAL_OK)
  {
    Error_Handler();
  }
  PeriphClkInit.PeriphClockSelection = RCC_PERIPHCLK_USART2;
  PeriphClkInit.Usart2ClockSelection = RCC_USART2CLKSOURCE_PCLK1;
  if (HAL_RCCEx_PeriphCLKConfig(&PeriphClkInit) != HAL_OK)
  {
    Error_Handler();
  }
}

/* USER CODE BEGIN 4 */
void glcd_init(void) {
	HAL_GPIO_WritePin(LCD_RST_GPIO_Port, LCD_RST_Pin, SET);	
	HAL_GPIO_WritePin(LCD_CS1_GPIO_Port, LCD_CS1_Pin, RESET);
	HAL_GPIO_WritePin(LCD_CS2_GPIO_Port, LCD_CS2_Pin, RESET);
	HAL_GPIO_WritePin(LCD_E_GPIO_Port, LCD_E_Pin, RESET);
	HAL_GPIO_WritePin(LCD_RS_GPIO_Port, LCD_RS_Pin, RESET);
	HAL_GPIO_WritePin(LCD_RW_GPIO_Port, LCD_RW_Pin, RESET);
	
	glcd_writeByte(PAGE0, INSTRUCTION, 0xc0);
	glcd_writeByte(PAGE1, INSTRUCTION, 0xc0);
	glcd_writeByte(PAGE0, INSTRUCTION, 0x3e);
	glcd_writeByte(PAGE1, INSTRUCTION, 0x3e);
}

void glcd_writeByte(uint8_t chip, uint8_t rs, uint8_t data) {
	
	if(chip == PAGE0) {
		HAL_GPIO_WritePin(LCD_CS1_GPIO_Port, LCD_CS1_Pin, SET);
	} else {
		HAL_GPIO_WritePin(LCD_CS2_GPIO_Port, LCD_CS2_Pin, SET);
	}
	
	HAL_GPIO_WritePin(LCD_RS_GPIO_Port, LCD_RS_Pin, (rs == DATA ? SET:RESET));
	HAL_GPIO_WritePin(LCD_RW_GPIO_Port, LCD_RW_Pin, RESET);
	
	HAL_GPIO_WritePin(LCD_DB0_GPIO_Port, LCD_DB0_Pin, ((data & 0x01) == 0x01 ? SET:RESET));
	HAL_GPIO_WritePin(LCD_DB1_GPIO_Port, LCD_DB1_Pin, ((data & 0x02) == 0x02 ? SET:RESET));
	HAL_GPIO_WritePin(LCD_DB2_GPIO_Port, LCD_DB2_Pin, ((data & 0x04) == 0x04 ? SET:RESET));
	HAL_GPIO_WritePin(LCD_DB3_GPIO_Port, LCD_DB3_Pin, ((data & 0x08) == 0x08 ? SET:RESET));
	HAL_GPIO_WritePin(LCD_DB4_GPIO_Port, LCD_DB4_Pin, ((data & 0x10) == 0x10 ? SET:RESET));
	HAL_GPIO_WritePin(LCD_DB5_GPIO_Port, LCD_DB5_Pin, ((data & 0x20) == 0x20 ? SET:RESET));
	HAL_GPIO_WritePin(LCD_DB6_GPIO_Port, LCD_DB6_Pin, ((data & 0x40) == 0x40 ? SET:RESET));
	HAL_GPIO_WritePin(LCD_DB7_GPIO_Port, LCD_DB7_Pin, ((data & 0x80) == 0x80 ? SET:RESET));
	
	HAL_GPIO_WritePin(LCD_E_GPIO_Port, LCD_E_Pin, SET);
	HAL_GPIO_WritePin(LCD_E_GPIO_Port, LCD_E_Pin, RESET);
	
	HAL_GPIO_WritePin(LCD_CS1_GPIO_Port, LCD_CS1_Pin, RESET);
	HAL_GPIO_WritePin(LCD_CS2_GPIO_Port, LCD_CS2_Pin, RESET);
}

void glcd_displayStatus(uint8_t status) {
	if(status == OFF) {
		glcd_writeByte(PAGE0, INSTRUCTION, 0x3e);
		glcd_writeByte(PAGE1, INSTRUCTION, 0x3e);
	} else if (status == ON) {
		glcd_writeByte(PAGE0, INSTRUCTION, 0x3f);
		glcd_writeByte(PAGE1, INSTRUCTION, 0x3f);
	}
}

void glcd_fillScreen(uint8_t pixelStatus) {
	uint8_t i, j;
	glcd_displayStatus(OFF);
	for(j = 0; j < 8; j++) {
		glcd_writeByte(PAGE0, INSTRUCTION, 0x40);
		glcd_writeByte(PAGE1, INSTRUCTION, 0x40);
		glcd_writeByte(PAGE0, INSTRUCTION, 0xb8 + j);
		glcd_writeByte(PAGE1, INSTRUCTION, 0xb8 + j);
		for(i = 0; i < 64; i++) {
			glcd_writeByte(PAGE0, DATA, 0xff * pixelStatus);
			glcd_writeByte(PAGE1, DATA, 0xff * pixelStatus);
		}
	}
	glcd_displayStatus(ON);
}

void glcd_drawImage(uint8_t imageArr[8][128]) {
	uint8_t i, j;
	glcd_displayStatus(OFF);
	for(j = 0; j < 8; j++) {
		glcd_writeByte(PAGE0, INSTRUCTION, 0x40);
		glcd_writeByte(PAGE0, INSTRUCTION, 0xb8 + j);
		for(i = 0; i < 64; i++) {
			glcd_writeByte(PAGE0, DATA, imageArr[j][i]);
		}
		
		glcd_writeByte(PAGE1, INSTRUCTION, 0x40);
		glcd_writeByte(PAGE1, INSTRUCTION, 0xb8 + j);
		for(i = 0; i < 64; i++) {
			glcd_writeByte(PAGE1, DATA, imageArr[j][64+i]);
		}
	}
	glcd_displayStatus(ON);
}

void glcd_loadingBar(void) {
	uint8_t i;
	
	glcd_writeByte(PAGE0, INSTRUCTION, 0x40 + 18);
	glcd_writeByte(PAGE0, INSTRUCTION, 0xbe);
	for(i = 0; i < (64 - 18); i++) {
		glcd_writeByte(PAGE0, DATA, 0xfc);
		HAL_Delay(25);
	}
	
	glcd_writeByte(PAGE1, INSTRUCTION, 0x40);
	glcd_writeByte(PAGE1, INSTRUCTION, 0xbe);
	for(i = 0; i < (64 - 16); i++) {
		glcd_writeByte(PAGE1, DATA, 0xfc);
		HAL_Delay(25);
	}
}
/* USER CODE END 4 */

/**
  * @brief  This function is executed in case of error occurrence.
  * @retval None
  */
void Error_Handler(void)
{
  /* USER CODE BEGIN Error_Handler_Debug */
  /* User can add his own implementation to report the HAL error return state */

  /* USER CODE END Error_Handler_Debug */
}

#ifdef  USE_FULL_ASSERT
/**
  * @brief  Reports the name of the source file and the source line number
  *         where the assert_param error has occurred.
  * @param  file: pointer to the source file name
  * @param  line: assert_param error line source number
  * @retval None
  */
void assert_failed(uint8_t *file, uint32_t line)
{ 
  /* USER CODE BEGIN 6 */
  /* User can add his own implementation to report the file name and line number,
     tex: printf("Wrong parameters value: file %s on line %d\r\n", file, line) */
  /* USER CODE END 6 */
}
#endif /* USE_FULL_ASSERT */

/************************ (C) COPYRIGHT STMicroelectronics *****END OF FILE****/
